// SPDX-License-Identifier: GPL-2.0-or-later OR MIT

#include "rk3568-fastrhino-r6xs.dtsi"

/ {
	model = "Lunzn FastRhino R66S";
	compatible = "lunzn,fastrhino-r66s", "rockchip,rk3568";

	aliases {
		ethernet0 = &rtl8125_1;
		ethernet1 = &rtl8125_2;
		mmc0 = &sdmmc0;
	};
};

&sdmmc0 {
	max-frequency = <150000000>;
	no-sdio;
	no-mmc;
	bus-width = <4>;
	cap-mmc-highspeed;
	cap-sd-highspeed;
	disable-wp;
	vmmc-supply = <&vcc3v3_sd>;
	vqmmc-supply = <&vccio_sd>;
	pinctrl-names = "default";
	pinctrl-0 = <&sdmmc0_bus4 &sdmmc0_clk &sdmmc0_cmd &sdmmc0_det>;
	status = "okay";
};
