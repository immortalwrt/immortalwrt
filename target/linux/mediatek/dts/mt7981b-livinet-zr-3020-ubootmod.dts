// SPDX-License-Identifier: GPL-2.0-or-later OR MIT

/dts-v1/;
#include "mt7981b-livinet-zr-3020.dts"

/ {
	model = "Livinet ZR-3020 (custom U-Boot layout)";
	compatible = "livinet,zr-3020-ubootmod", "mediatek,mt7981";
};

&partitions {
	/delete-node/ partition@4580000;
};

&ubi {
	reg = <0x580000 0x6000000>;
};
