// SPDX-License-Identifier: GPL-2.0-or-later OR MIT

#include "ipq6018.dtsi"

&q6_region {
	reg = <0x0 0x4ab00000 0x0 0x1000000>;
};

&q6_etr_region {
	reg = <0x0 0x4bb00000 0x0 0x100000>;
};

&m3_dump_region {
	reg = <0x0 0x4bc00000 0x0 0x100000>;
};

&ramoops_region {
	reg = <0x0 0x4bd00000 0x0 0x100000>;
};
