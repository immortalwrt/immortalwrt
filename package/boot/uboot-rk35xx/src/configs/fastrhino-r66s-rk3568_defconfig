## package/emortal/mt7622/config.in
```kconfig
if PACKAGE_kmod-mt7622

config MTK_APSOC_WIFI_SUPPORT_OPENWRT
	bool
	default y
	depends on PACKAGE_kmod-mt7622

config MTK_APSOC_WIFI_WIFI_DRIVER
	bool
	default y
	depends on PACKAGE_kmod-mt7622

config MTK_APSOC_WIFI_MT_WIFI
	tristate "MT WIFI Driver"
	select MTK_APSOC_WIFI_WIFI_BASIC_FUNC if MTK_APSOC_WIFI_MT_WIFI
	default y
	
config MTK_APSOC_WIFI_MT_WIFI_PATH
	string
	depends on MTK_APSOC_WIFI_MT_WIFI
	default "7622_mt_wifi"

if MTK_APSOC_WIFI_WIFI_DRIVER

choice
	prompt "Choose First WiFi Interface"
	
	config MTK_APSOC_WIFI_FIRST_IF_MT7622
	bool "MT7622"
	select MTK_APSOC_WIFI_WIFI_MT_MAC
	select MTK_APSOC_WIFI_MT_MAC
	select MTK_APSOC_WIFI_CHIP_MT7622
	
	config MTK_APSOC_WIFI_FIRST_IF_NONE
	bool "None"

	

endchoice

choice
	prompt "Choose Second WiFi Interface"
	
	config MTK_APSOC_WIFI_SECOND_IF_MT7915
	bool "MT7915"
	select MTK_APSOC_WIFI_CHIP_MT7915
	select MTK_APSOC_WIFI_MULTI_INF_SUPPORT

	config MTK_APSOC_WIFI_SECOND_IF_NONE
	bool "None"

	config MTK_APSOC_WIFI_SECOND_IF_MT7615E
	bool "MT7615E"
	select MTK_APSOC_WIFI_CHIP_MT7615E
	select MTK_APSOC_WIFI_MULTI_INF_SUPPORT

endchoice

choice
	prompt "Choose Third WiFi Interface"
	config MTK_APSOC_WIFI_THIRD_IF_NONE
	bool "None"

	config MTK_APSOC_WIFI_THIRD_IF_MT7615E
	bool "MT7615E"
	select MTK_APSOC_WIFI_CHIP_MT7615E
	select MTK_APSOC_WIFI_MULTI_INF_SUPPORT

	config MTK_APSOC_WIFI_THIRD_IF_MT7915
	bool "MT7915"
	select MTK_APSOC_WIFI_CHIP_MT7915
	select MTK_APSOC_WIFI_MULTI_INF_SUPPORT

endchoice

config  MTK_APSOC_WIFI_RT_FIRST_CARD
	int
	depends on ! MTK_APSOC_WIFI_FIRST_IF_NONE
	default 7622 if MTK_APSOC_WIFI_FIRST_IF_MT7622

config  MTK_APSOC_WIFI_RT_SECOND_CARD
	int
	depends on ! MTK_APSOC_WIFI_SECOND_IF_NONE
	default 7615 if MTK_APSOC_WIFI_SECOND_IF_MT7615E
	default 7915 if MTK_APSOC_WIFI_SECOND_IF_MT7915

config  MTK_APSOC_WIFI_RT_THIRD_CARD
	int
	depends on ! MTK_APSOC_WIFI_THIRD_IF_NONE
	default 7615 if MTK_APSOC_WIFI_THIRD_IF_MT7615E
	default 7915 if MTK_APSOC_WIFI_THIRD_IF_MT7915

config  MTK_APSOC_WIFI_RT_FIRST_IF_RF_OFFSET
	hex
	depends on ! MTK_APSOC_WIFI_FIRST_IF_NONE
	default 0xc0000

config  MTK_APSOC_WIFI_RT_SECOND_IF_RF_OFFSET
	hex
	depends on ! MTK_APSOC_WIFI_SECOND_IF_NONE
	default 0xc8000

config  MTK_APSOC_WIFI_RT_THIRD_IF_RF_OFFSET
	hex
	depends on ! MTK_APSOC_WIFI_THIRD_IF_NONE
	default 0xd0000

if MTK_APSOC_WIFI_MT_WIFI
menu "WiFi Generic Feature Options"
choice
	prompt "EEPROM Type of 1st Card"
	depends on ! MTK_APSOC_WIFI_FIRST_IF_NONE

	config MTK_APSOC_WIFI_FIRST_IF_EEPROM_FLASH
	bool "FLASH"

	config MTK_APSOC_WIFI_FIRST_IF_EEPROM_PROM
	bool "EEPROM"

	config MTK_APSOC_WIFI_FIRST_IF_EEPROM_EFUSE
	bool "EFUSE"

endchoice

config MTK_APSOC_WIFI_RT_FIRST_CARD_EEPROM
	string
	depends on ! MTK_APSOC_WIFI_FIRST_IF_NONE
	default "prom" if MTK_APSOC_WIFI_FIRST_IF_EEPROM_PROM
	default "efuse" if MTK_APSOC_WIFI_FIRST_IF_EEPROM_EFUSE
	default "flash" if MTK_APSOC_WIFI_FIRST_IF_EEPROM_FLASH

choice
	prompt "EEPROM Type of 2nd Card"
	depends on ! MTK_APSOC_WIFI_SECOND_IF_NONE

	config MTK_APSOC_WIFI_SECOND_IF_EEPROM_FLASH
	bool "FLASH"

	config MTK_APSOC_WIFI_SECOND_IF_EEPROM_PROM
	bool "EEPROM"

	config MTK_APSOC_WIFI_SECOND_IF_EEPROM_EFUSE
	bool "EFUSE"

endchoice

config MTK_APSOC_WIFI_RT_SECOND_CARD_EEPROM
	string
	depends on ! MTK_APSOC_WIFI_SECOND_IF_NONE
	default "prom" if MTK_APSOC_WIFI_SECOND_IF_EEPROM_PROM
	default "efuse" if MTK_APSOC_WIFI_SECOND_IF_EEPROM_EFUSE
	default "flash" if MTK_APSOC_WIFI_SECOND_IF_EEPROM_FLASH

choice
	prompt "EEPROM Type of 3th Card"
	depends on ! MTK_APSOC_WIFI_THIRD_IF_NONE

	config MTK_APSOC_WIFI_THIRD_IF_EEPROM_FLASH
	bool "FLASH"

	config MTK_APSOC_WIFI_THIRD_IF_EEPROM_PROM
	bool "EEPROM"

	config MTK_APSOC_WIFI_THIRD_IF_EEPROM_EFUSE
	bool "EFUSE"

endchoice

config MTK_APSOC_WIFI_RT_THIRD_CARD_EEPROM
	string
	depends on ! MTK_APSOC_WIFI_THIRD_IF_NONE
	default "prom" if MTK_APSOC_WIFI_THIRD_IF_EEPROM_PROM
	default "efuse" if MTK_APSOC_WIFI_THIRD_IF_EEPROM_EFUSE
	default "flash" if MTK_APSOC_WIFI_THIRD_IF_EEPROM_FLASH

config MTK_APSOC_WIFI_MULTI_INF_SUPPORT
	bool
	default y 

config MTK_APSOC_WIFI_MT76XX_COMBO_DUAL_DRIVER_SUPPORT
	bool "MT76XX Combo Dual Driver support"
#	depends on (MTK_APSOC_WIFI_CHIP_MT7622 && MTK_APSOC_WIFI_CHIP_MT7915)
	default y

config MTK_APSOC_WIFI_WIFI_BASIC_FUNC
	bool "Basic Functions"
	select MTK_APSOC_WIFI_WIRELESS_EXT
	select MTK_APSOC_WIFI_WEXT_SPY
	select MTK_APSOC_WIFI_WEXT_PRIV

config MTK_APSOC_WIFI_DOT11_N_SUPPORT
	bool "802.11n support"
	default y

config MTK_APSOC_WIFI_DOT11_VHT_AC
	bool "802.11AC support"
	depends on MTK_APSOC_WIFI_WIFI_DRIVER
	depends on MTK_APSOC_WIFI_DOT11_N_SUPPORT
	default y

config MTK_APSOC_WIFI_G_BAND_256QAM_SUPPORT
	bool "2.4G 256QAM support"
	depends on MTK_APSOC_WIFI_WIFI_DRIVER
	depends on MTK_APSOC_WIFI_DOT11_VHT_AC
        default y

config MTK_APSOC_WIFI_BRCM_256QAM_SUPPORT
	bool "BRCM 2.4G 256QAM support"
	depends on MTK_APSOC_WIFI_WIFI_DRIVER
	depends on MTK_APSOC_WIFI_G_BAND_256QAM_SUPPORT
	default y

config MTK_APSOC_WIFI_VHT_TXBF_2G_EPIGRAM_IE_SUPPORT
    bool "BRCM 2.4G VHT Sounding support"
	depends on MTK_APSOC_WIFI_WIFI_DRIVER
	default y

config MTK_APSOC_WIFI_TPC_SUPPORT
	bool "802.11h TPC Support"
	depends on MTK_APSOC_WIFI_WIFI_DRIVER
	default y

config MTK_APSOC_WIFI_ICAP_SUPPORT
	bool "ICAP Support"
	depends on MTK_APSOC_WIFI_WIFI_DRIVER
	depends on MTK_APSOC_WIFI_MT_AP_SUPPORT
	default y

config MTK_APSOC_WIFI_SPECTRUM_SUPPORT
	bool "Wifi Spectrum Support"
	depends on MTK_APSOC_WIFI_WIFI_DRIVER
	depends on MTK_APSOC_WIFI_MT_AP_SUPPORT
	default y

config MTK_APSOC_WIFI_BACKGROUND_SCAN_SUPPORT
	bool "Background Scan Support"
	depends on MTK_APSOC_WIFI_WIFI_DRIVER
	default y

config MTK_APSOC_WIFI_SMART_CARRIER_SENSE_SUPPORT
	bool "Smart Carrier Sense Support"
	depends on MTK_APSOC_WIFI_WIFI_DRIVER
	default y

#config MTK_APSOC_WIFI_MT_DFS_SUPPORT
#	bool "Dynamic Frequency Selection Support"
#	depends on MTK_APSOC_WIFI_WIFI_DRIVER
#	default n

config MTK_APSOC_WIFI_OFFCHANNEL_SCAN_FEATURE
	bool "Channel Quality Monitor"
	depends on MTK_APSOC_WIFI_WIFI_DRIVER
	depends on MTK_APSOC_WIFI_MT_AP_SUPPORT
	default n

#config MTK_APSOC_WIFI_WFA_VHT_R2_PF
#	bool "WFA VHT R2 Plugfest"
#	depends on MTK_APSOC_WIFI_DOT11_VHT_AC
#	default n

config MTK_APSOC_WIFI_HDR_TRANS_TX_SUPPORT
	bool "Tx Header Translation"
	depends on MTK_APSOC_WIFI_CHIP_MT7622
	default y

config MTK_APSOC_WIFI_HDR_TRANS_RX_SUPPORT
	bool "Rx Header Translation"
	depends on MTK_APSOC_WIFI_CHIP_MT7622
	default y

config MTK_APSOC_WIFI_WSC_INCLUDED
	bool "WSC (WiFi Simple Config)"
	depends on MTK_APSOC_WIFI_WIFI_DRIVER
	depends on MTK_APSOC_WIFI_MT_AP_SUPPORT || MTK_APSOC_WIFI_MT_STA_SUPPORT
	default y

config MTK_APSOC_WIFI_WSC_V2_SUPPORT
	bool "WSC V2(WiFi Simple Config Version 2.0)"
	depends on MTK_APSOC_WIFI_WIFI_DRIVER
	depends on MTK_APSOC_WIFI_MT_AP_SUPPORT || MTK_APSOC_WIFI_MT_STA_SUPPORT
	default y

config MTK_APSOC_WIFI_DOT11W_PMF_SUPPORT
	bool "PMF"
	depends on MTK_APSOC_WIFI_WIFI_DRIVER
	depends on MTK_APSOC_WIFI_MT_AP_SUPPORT || MTK_APSOC_WIFI_MT_STA_SUPPORT
	default y

config MTK_APSOC_WIFI_TXBF_SUPPORT
	bool "Tx Bean Forming Support"
	depends on MTK_APSOC_WIFI_WIFI_DRIVER
	default y

config MTK_APSOC_WIFI_FAST_NAT_SUPPORT
	bool "Fast-NAT support"
#	depends on MTK_APSOC_WIFI_RA_HW_NAT_WIFI
	default n

#config MTK_APSOC_WIFI_LLTD_SUPPORT
#	bool "LLTD (Link Layer Topology Discovery Protocol)"
#	depends on MTK_APSOC_WIFI_WIFI_DRIVER
#	depends on MTK_APSOC_WIFI_MT_AP_SUPPORT
#	default n

#config MTK_APSOC_WIFI_QOS_DLS_SUPPORT
#	bool "802.11e DLS ((Direct-Link Setup) Support"
#	depends on MTK_APSOC_WIFI_WIFI_DRIVER
#	depends on MTK_APSOC_WIFI_MT_AP_SUPPORT
#	default n

#config MTK_APSOC_WIFI_WAPI_SUPPORT
#	bool "WAPI Support"
#	depends on MTK_APSOC_WIFI_WIFI_DRIVER
#	default n

config MTK_APSOC_WIFI_FTM_SUPPORT
	bool "FTM Support"
	depends on MTK_APSOC_WIFI_WIFI_DRIVER
	select MTK_APSOC_WIFI_PASSPOINT_R2
	default n

#config MTK_APSOC_WIFI_CARRIER_DETECTION_SUPPORT
#	bool "Carrier Detect"
#	depends on MTK_APSOC_WIFI_WIFI_DRIVER
#	default n

config MTK_APSOC_WIFI_IGMP_SNOOP_SUPPORT
	bool "IGMP snooping"
	depends on MTK_APSOC_WIFI_WIFI_DRIVER
	depends on MTK_APSOC_WIFI_MT_AP_SUPPORT
	default y

#config MTK_APSOC_WIFI_BLOCK_NET_IF
#	bool "NETIF Block"
#	depends on MTK_APSOC_WIFI_WIFI_DRIVER
#	depends on MTK_APSOC_WIFI_MT_AP_SUPPORT
#	default n
#	help
#	Support Net interface block while Tx-Sw queue full

#config MTK_APSOC_WIFI_RATE_ADAPTION
#	bool "New Rate Adaptation support"
#	depends on MTK_APSOC_WIFI_WIFI_DRIVER
#	default y

#config MTK_APSOC_WIFI_NEW_RATE_ADAPT_SUPPORT
#	bool "Intelligent Rate Adaption"
#	depends on MTK_APSOC_WIFI_WIFI_DRIVER && MTK_APSOC_WIFI_RATE_ADAPTION
#	default y

#config MTK_APSOC_WIFI_AGS_SUPPORT
#	bool "Adaptive Group Switching"
#	depends on MTK_APSOC_WIFI_WIFI_DRIVER && MTK_APSOC_WIFI_RATE_ADAPTION
#	depends on MTK_APSOC_WIFI_MT_AP_SUPPORT || MTK_APSOC_WIFI_MT_STA_SUPPORT
#	default n

#config MTK_APSOC_WIFI_RATE_ADAPT_AGBS_SUPPORT
#	bool "Adaptive AGBS Mode"
#	depends on MTK_APSOC_WIFI_WIFI_DRIVER && MTK_APSOC_WIFI_RATE_ADAPTION
#	depends on MTK_APSOC_WIFI_MT_AP_SUPPORT || MTK_APSOC_WIFI_MT_STA_SUPPORT
#	default y

#config MTK_APSOC_WIFI_IDS_SUPPORT
#	bool "IDS (Intrusion Detection System) Support"
#	depends on MTK_APSOC_WIFI_WIFI_DRIVER
#	depends on MTK_APSOC_WIFI_MT_AP_SUPPORT
#	default n

#config MTK_APSOC_WIFI_WIFI_WORK_QUEUE
#	bool "Work Queue"
#	depends on MTK_APSOC_WIFI_WIFI_DRIVER
#	default n

#config MTK_APSOC_WIFI_WIFI_SKB_RECYCLE
#	bool "SKB Recycle(Linux)"
#	depends on MTK_APSOC_WIFI_WIFI_DRIVER
#	depends on MTK_APSOC_WIFI_MT_AP_SUPPORT
#	default n

config MTK_APSOC_WIFI_RTMP_FLASH_SUPPORT
	bool "Flash Support"
	depends on MTK_APSOC_WIFI_WIFI_DRIVER
	default y

config MTK_APSOC_WIFI_PRE_CAL_TRX_SET1_SUPPORT
	bool "Calibration To Flash/BinFile Support"
	depends on MTK_APSOC_WIFI_WIFI_DRIVER
	default n

config MTK_APSOC_WIFI_RLM_CAL_CACHE_SUPPORT
	bool "RlmCalibrationCache Support"
	depends on MTK_APSOC_WIFI_WIFI_DRIVER
	default n

config MTK_APSOC_WIFI_CAL_BIN_FILE_SUPPORT
	bool "Calibration to BinFile Support"
	depends on MTK_APSOC_WIFI_WIFI_DRIVER
	default n

config MTK_APSOC_WIFI_RF_LOCKDOWN_SUPPORT
	bool "RF Lockdown Support"
	depends on MTK_APSOC_WIFI_WIFI_DRIVER
	default n

#config MTK_APSOC_WIFI_LED_CONTROL_SUPPORT
#	bool "LED Support"
#	depends on MTK_APSOC_WIFI_WIFI_DRIVER
#	depends on MTK_APSOC_WIFI_MT_AP_SUPPORT
#	default n

config MTK_APSOC_WIFI_ATE_SUPPORT
	bool "ATE/QA Support"
	depends on MTK_APSOC_WIFI_WIFI_DRIVER
	default y

#config MTK_APSOC_WIFI_MEMORY_OPTIMIZATION
#	bool "Memory Optimization"
#	depends on MTK_APSOC_WIFI_WIFI_DRIVER
#	default n

config MTK_APSOC_WIFI_PASSPOINT_R2
	bool "Passpoint Release-2 Support"
	depends on MTK_APSOC_WIFI_WIFI_DRIVER
	select MTK_APSOC_WIFI_DOT11W_PMF_SUPPORT
	depends on MTK_APSOC_WIFI_MT_AP_SUPPORT
	default n

config MTK_APSOC_WIFI_MBO_SUPPORT
	bool "MBO Support"
	depends on MTK_APSOC_WIFI_WIFI_DRIVER
	select MTK_APSOC_WIFI_INTERWORKING
	select MTK_APSOC_WIFI_WNM_SUPPORT
	select MTK_APSOC_WIFI_DOT11K_RRM_SUPPORT
	select MTK_APSOC_WIFI_DOT11R_FT_SUPPORT
	select MTK_APSOC_WIFI_DOT11W_PMF_SUPPORT
	default n

config MTK_APSOC_WIFI_MAP_SUPPORT
	bool "MAP Support"
	depends on MTK_APSOC_WIFI_WIFI_DRIVER
	select MTK_APSOC_WIFI_INTERWORKING
	select MTK_APSOC_WIFI_WNM_SUPPORT
	select MTK_APSOC_WIFI_DOT11K_RRM_SUPPORT
	select MTK_APSOC_WIFI_DOT11R_FT_SUPPORT
	select MTK_APSOC_WIFI_DOT11W_PMF_SUPPORT
	default n

config MTK_APSOC_WIFI_MAP_R2_VER_SUPPORT
	bool "Multi-AP R2 version support"
	depends on MTK_APSOC_WIFI_MAP_SUPPORT
	default n

#config MTK_APSOC_WIFI_TRACE_TCP_PKT
#	   bool "TCP DATA/ACK packets trace log"
#	   depends on MTK_APSOC_WIFI_WIFI_DRIVER
#	   default n

config MTK_APSOC_WIFI_UAPSD
	bool "UAPSD support"
	depends on MTK_APSOC_WIFI_WIFI_DRIVER
	depends on MTK_APSOC_WIFI_MT_AP_SUPPORT || MTK_APSOC_WIFI_MT_STA_SUPPORT
	default y

config MTK_APSOC_WIFI_TCP_RACK_SUPPORT
	bool "TCP Reduced ACK  support"
	depends on MTK_APSOC_WIFI_WIFI_DRIVER
	default n

#### PA_LNA_Type choice

config MTK_APSOC_WIFI_RED_SUPPORT
	bool "RED(Random Early Drop) support"
	depends on MTK_APSOC_WIFI_WIFI_DRIVER
	depends on MTK_APSOC_WIFI_MT_AP_SUPPORT || MTK_APSOC_WIFI_MT_STA_SUPPORT
	default y

config MTK_APSOC_WIFI_FQ_SCH_SUPPORT
	bool "Fair Queueing support"
	depends on MTK_APSOC_WIFI_WIFI_DRIVER
	depends on MTK_APSOC_WIFI_MT_AP_SUPPORT && MTK_APSOC_WIFI_VOW_SUPPORT
	depends on MTK_APSOC_WIFI_CHIP_MT7622
	default y

choice
	prompt "PA LNA Type of 1st Card"
	depends on ! MTK_APSOC_WIFI_FIRST_IF_NONE

	config MTK_APSOC_WIFI_FIRST_IF_IPAILNA
	bool "iPAiLNA"
	config MTK_APSOC_WIFI_FIRST_IF_EPAELNA
	bool "ePAeLNA"
	config MTK_APSOC_WIFI_FIRST_IF_IPAELNA
	bool "iPAeLNA"
#	config MTK_APSOC_WIFI_FIRST_IF_EPAILNA
#	bool "ePAiLNA"
endchoice
choice
	prompt "PA LNA Type of 2nd Card"
	depends on ! MTK_APSOC_WIFI_SECOND_IF_NONE

	config MTK_APSOC_WIFI_SECOND_IF_EPAELNA
	bool "ePAeLNA"
	config MTK_APSOC_WIFI_SECOND_IF_IPAILNA
	bool "iPAiLNA"
	config MTK_APSOC_WIFI_SECOND_IF_IPAELNA
	bool "iPAeLNA"
#		config MTK_APSOC_WIFI_SECOND_IF_EPAILNA
#		bool "ePAiLNA"
endchoice
choice
	prompt "PA LNA Type of 3rd Card"
	depends on ! MTK_APSOC_WIFI_THIRD_IF_NONE

	config MTK_APSOC_WIFI_THIRD_IF_EPAELNA
	bool "ePAeLNA"
	config MTK_APSOC_WIFI_THIRD_IF_IPAILNA
	bool "iPAiLNA"
	config MTK_APSOC_WIFI_THIRD_IF_IPAELNA
	bool "iPAeLNA"
#	config MTK_APSOC_WIFI_THIRD_IF_EPAILNA
#	bool "ePAiLNA"
endchoice
#### PA_LNA_Type choice END

#
# Section for chip architectures
#
# "RLT MAC Support"
config MTK_APSOC_WIFI_RLT_MAC
	bool
	depends on MTK_APSOC_WIFI_WIFI_DRIVER
	default n

config MTK_APSOC_WIFI_RLT_BBP
	bool

config MTK_APSOC_WIFI_RLT_RF
	bool

# "RTMP MAC Support"
config MTK_APSOC_WIFI_RTMP_MAC
	bool
	depends on MTK_APSOC_WIFI_WIFI_DRIVER
	default n

config MTK_APSOC_WIFI_RTMP_BBP
	bool

config MTK_APSOC_WIFI_RTMP_RF
	bool

#
# Section for interfaces
#
config MTK_APSOC_WIFI_RTMP_PCI_SUPPORT
	bool

config MTK_APSOC_WIFI_RTMP_USB_SUPPORT
	bool

config MTK_APSOC_WIFI_RTMP_RBUS_SUPPORT
	bool

endmenu

menu "WiFi Operation Modes"

	config MTK_APSOC_WIFI_WIFI_MODE_AP
		tristate "AP"
		select MTK_APSOC_WIFI_MT_AP_SUPPORT
		default m
		

	config MTK_APSOC_WIFI_WIFI_MODE_STA
		tristate "STA"
		select MTK_APSOC_WIFI_MT_STA_SUPPORT

	config MTK_APSOC_WIFI_WIFI_MODE_BOTH
		tristate "APSTA"
		select MTK_APSOC_WIFI_MT_AP_SUPPORT
		select MTK_APSOC_WIFI_MT_STA_SUPPORT



config MTK_APSOC_WIFI_MT_AP_SUPPORT
	tristate "Ralink RT2860 802.11n AP support"
#	depends on NET_RADIO
	select MTK_APSOC_WIFI_WIRELESS_EXT
	select MTK_APSOC_WIFI_WEXT_SPY
	select MTK_APSOC_WIFI_WEXT_PRIV
	default y

config MTK_APSOC_WIFI_WDS_SUPPORT
	bool "WDS"
	depends on MTK_APSOC_WIFI_MT_AP_SUPPORT
	default y

config MTK_APSOC_WIFI_MBSS_SUPPORT
	bool "MBSSID"
	depends on MTK_APSOC_WIFI_MT_AP_SUPPORT
	default y

#config MTK_APSOC_WIFI_NEW_MBSSID_MODE
#	bool "New MBSSID MODE"
#	depends on MTK_APSOC_WIFI_MT_AP_SUPPORT && MTK_APSOC_WIFI_MBSS_SUPPORT
#	depends on MTK_APSOC_WIFI_RALINK_RT3883 || MTK_APSOC_WIFI_RALINK_RT3352 || MTK_APSOC_WIFI_RALINK_RT5350 || MTK_APSOC_WIFI_RALINK_RT6352 || MTK_APSOC_WIFI_RALINK_MT7620
#	default y

#config MTK_APSOC_WIFI_ENHANCE_NEW_MBSSID_MODE
#	bool "Enhanced MBSSID mode"
#	depends on MTK_APSOC_WIFI_NEW_MBSSID_MODE
#	default y

config MTK_APSOC_WIFI_APCLI_SUPPORT
	bool "AP-Client Support"
	depends on MTK_APSOC_WIFI_MT_AP_SUPPORT
	default y

config MTK_APSOC_WIFI_APCLI_CERT_SUPPORT
	bool "AP-Client TGn Cert Support"
	depends on MTK_APSOC_WIFI_MT_AP_SUPPORT
	depends on MTK_APSOC_WIFI_APCLI_SUPPORT
        default n

config MTK_APSOC_WIFI_MAC_REPEATER_SUPPORT
	bool "MAC Repeater Support"
	depends on MTK_APSOC_WIFI_MT_AP_SUPPORT
	depends on MTK_APSOC_WIFI_APCLI_SUPPORT
	default y

config MTK_APSOC_WIFI_APCLI_CONNECTION_TRIAL
	bool "Trial Connection"
	depends on MTK_APSOC_WIFI_MT_AP_SUPPORT
	depends on MTK_APSOC_WIFI_APCLI_SUPPORT
	default n

config MTK_APSOC_WIFI_MWDS
	bool "Mixed WDS(MWDS)"
	depends on MTK_APSOC_WIFI_MT_AP_SUPPORT
	select MTK_APSOC_WIFI_APCLI_SUPPORT
	default n

config MTK_APSOC_WIFI_MUMIMO_SUPPORT
	bool "MU-MIMO Support"
	depends on MTK_APSOC_WIFI_WIFI_DRIVER
	select MTK_APSOC_WIFI_MU_RA_SUPPORT
	default y

config MTK_APSOC_WIFI_MU_RA_SUPPORT
  	bool "MU-RGA Support"
  	depends on MTK_APSOC_WIFI_MUMIMO_SUPPORT

config MTK_APSOC_WIFI_DOT11R_FT_SUPPORT
	bool "802.11r Fast BSS Transition"
	depends on MTK_APSOC_WIFI_MT_AP_SUPPORT
	default n

config MTK_APSOC_WIFI_DOT11K_RRM_SUPPORT
	bool "802.11k Radio Resource Management"
	depends on MTK_APSOC_WIFI_MT_AP_SUPPORT
	default y

config MTK_APSOC_WIFI_ENTERPRISE_AP_SUPPORT
	bool "Enterprise AP Support"
	depends on MTK_APSOC_WIFI_MT_AP_SUPPORT
	default n

config MTK_APSOC_WIFI_MLME_MULTI_QUEUE_SUPPORT
	bool "Mlme Multi Queue Support"
	depends on MTK_APSOC_WIFI_MT_AP_SUPPORT
	default n

config MTK_APSOC_WIFI_WIFI_EAP_FEATURE
	bool "EAP Feature"
	depends on MTK_APSOC_WIFI_WIFI_DRIVER
	depends on MTK_APSOC_WIFI_MT_AP_SUPPORT
	default n

config MTK_APSOC_WIFI_VLAN_SUPPORT
	bool "VLAN Support"
	depends on MTK_APSOC_WIFI_WIFI_EAP_FEATURE
	default n

config MTK_APSOC_WIFI_TXRX_STAT_SUPPORT
	bool "TxRx Stats Support"
	depends on MTK_APSOC_WIFI_WIFI_EAP_FEATURE
	default n

config MTK_APSOC_WIFI_SNIFFER_SUPPORT
	bool "SNIFFER"
	depends on MTK_APSOC_WIFI_WIFI_EAP_FEATURE
	default n

config MTK_APSOC_WIFI_ANTENNA_CONTROL_SUPPORT
	bool "Antenna Control"
	depends on MTK_APSOC_WIFI_WIFI_EAP_FEATURE
	default n

config MTK_APSOC_WIFI_MGMT_TXPWR_CTRL
	bool "Mgmt TxPower Control"
	depends on MTK_APSOC_WIFI_WIFI_EAP_FEATURE
	default n

config MTK_APSOC_WIFI_CHUTIL_SUPPORT
	bool "Channel Utilization Support"
	depends on MTK_APSOC_WIFI_WIFI_EAP_FEATURE
	default n

config MTK_APSOC_WIFI_NF_SUPPORT
	bool "Noise Floor Support"
	depends on MTK_APSOC_WIFI_WIFI_EAP_FEATURE
	default n

config MTK_APSOC_WIFI_RA_PHY_RATE_SUPPORT
	bool "RA PHY RATE Support"
	depends on MTK_APSOC_WIFI_WIFI_EAP_FEATURE
	default n

config MTK_APSOC_WIFI_AMPDU_CONF_SUPPORT
	bool "AMPDU Config retry & agglimitSupport"
	depends on MTK_APSOC_WIFI_WIFI_EAP_FEATURE
	default n

config MTK_APSOC_WIFI_ACK_CTS_TIMEOUT_SUPPORT
	bool "ACK CTS Timeout cck & ofdm Support"
	depends on MTK_APSOC_WIFI_WIFI_EAP_FEATURE
	default n

config MTK_APSOC_WIFI_RADIUS_MAC_AUTH_SUPPORT
	bool "RADIUS MAC Auth Support"
	depends on MTK_APSOC_WIFI_ENTERPRISE_AP_SUPPORT
	depends on MTK_APSOC_WIFI_CFG80211_SUPPORT
	default n

config MTK_APSOC_WIFI_DYNAMIC_VLAN_SUPPORT
	bool "Dynamic VLAN Support"
	depends on MTK_APSOC_WIFI_MT_AP_SUPPORT
	depends on MTK_APSOC_WIFI_ENTERPRISE_AP_SUPPORT
	default n

config MTK_APSOC_WIFI_CFG80211_SUPPORT
	bool "CFG80211"
	depends on MTK_APSOC_WIFI_MT_AP_SUPPORT
	default n

#CUSTOMISED HOSTAPD
config MTK_APSOC_WIFI_CUSTOMISED_HOSTAPD_SUPPORT
	bool "Customised Hostapd Support"
	depends on MTK_APSOC_WIFI_MT_AP_SUPPORT
	depends on MTK_APSOC_WIFI_CFG80211_SUPPORT
	default n

#APCLI STA
config MTK_APSOC_WIFI_APCLI_STA_SUPPORT
	bool "APCLI STA Support"
	depends on MTK_APSOC_WIFI_APCLI_SUPPORT
	depends on MTK_APSOC_WIFI_CFG80211_SUPPORT
	default n

#WDS STA
config MTK_APSOC_WIFI_WDS_STA_SUPPORT
	bool "WDS STA Support"
	depends on MTK_APSOC_WIFI_APCLI_SUPPORT
	depends on MTK_APSOC_WIFI_CFG80211_SUPPORT
	default n

#WDS AP
config MTK_APSOC_WIFI_MBSS_AS_WDS_AP_SUPPORT
	bool "MBSS AS WDS AP Support"
	depends on MTK_APSOC_WIFI_MT_AP_SUPPORT
	depends on MTK_APSOC_WIFI_MBSS_SUPPORT
	default n

config MTK_APSOC_WIFI_DSCP_QOS_MAP_SUPPORT
	bool "Dscp Qos Mapping Support"
	depends on MTK_APSOC_WIFI_MT_AP_SUPPORT
	default n

config MTK_APSOC_WIFI_DSCP_PRI_SUPPORT
	bool "Dscp Priority Mapping Support"
	depends on MTK_APSOC_WIFI_MT_AP_SUPPORT
	default n

config MTK_APSOC_WIFI_MIN_PHY_RATE_SUPPORT
	bool "Minimum PHY rate support"
	depends on MTK_APSOC_WIFI_MT_AP_SUPPORT
	default n

config MTK_APSOC_WIFI_FAST_UP_RATE_SUPPORT
	bool "Fast UP rate support"
	depends on MTK_APSOC_WIFI_MT_AP_SUPPORT
	default n

config MTK_APSOC_WIFI_CON_WPS_SUPPORT
	bool "Concurrent WPS Support"
	depends on MTK_APSOC_WIFI_MT_AP_SUPPORT
	depends on MTK_APSOC_WIFI_APCLI_SUPPORT
	depends on MTK_APSOC_WIFI_WSC_INCLUDED
	depends on MTK_APSOC_WIFI_WSC_V2_SUPPORT
#	depends on MTK_APSOC_WIFI_MULTI_INF_SUPPORT
	default n

#config MTK_APSOC_WIFI_LLTD_SUPPORT
#	bool "LLTD (Link Layer Topology Discovery Protocol)"
#	depends on MTK_APSOC_WIFI_MT_AP_SUPPORT

#config MTK_APSOC_WIFI_COC_SUPPORT
#	bool "CoC Support"
#	depends on MTK_APSOC_WIFI_MT_AP_SUPPORT
#	default n

#config  MTK_APSOC_WIFI_RT2860V2_SNMP
#	bool "Net-SNMP Support"
#	depends on MTK_APSOC_WIFI_MT_AP_SUPPORT

config MTK_APSOC_WIFI_MCAST_RATE_SPECIFIC
	bool "User specific tx rate of mcast pkt"
	depends on MTK_APSOC_WIFI_MT_AP_SUPPORT
	default y

#config MTK_APSOC_WIFI_EXT_BUILD_CHANNEL_LIST
#	bool "Extension Channel List"
#	depends on MTK_APSOC_WIFI_MT_AP_SUPPORT

#config MTK_APSOC_WIFI_AUTO_CH_SELECT_ENHANCE
#	bool "Auto Channel Selection Enhancement"
#	depends on MTK_APSOC_WIFI_MT_AP_SUPPORT

config MTK_APSOC_WIFI_VOW_SUPPORT
	bool "MediaAir(VOW) support"
	depends on MTK_APSOC_WIFI_MT_AP_SUPPORT
	default y

#config MTK_APSOC_WIFI_AIRPLAY_SUPPORT
#	bool "AIRPLAY Support"
#	depends on MTK_APSOC_WIFI_MT_AP_SUPPORT
#	default n

config MTK_APSOC_WIFI_BAND_STEERING
	bool "Band Steering"
	depends on MTK_APSOC_WIFI_MT_AP_SUPPORT
	default y

config MTK_APSOC_WIFI_LED_CONTROL_SUPPORT
	bool "LED Control Support"
	default n

config MTK_APSOC_WIFI_WLAN_HOOK
	bool "WLAN hook Support"
	depends on MTK_APSOC_WIFI_WIFI_DRIVER
	default n

config MTK_APSOC_WIFI_RADIUS_ACCOUNTING_SUPPORT
	bool "Radius Accounting Support"
	depends on MTK_APSOC_WIFI_MT_AP_SUPPORT
	default n

config MTK_APSOC_WIFI_GREENAP_SUPPORT
	bool "GreenAP Support"
	depends on MTK_APSOC_WIFI_MT_AP_SUPPORT
	default y

config MTK_APSOC_WIFI_VENDOR_FEATURE11_SUPPORT
	bool "Vendor11 Feature Enable"
	depends on MTK_APSOC_WIFI_WIFI_DRIVER
	depends on MTK_APSOC_WIFI_MT_AP_SUPPORT
	default n

config MTK_APSOC_WIFI_PCIE_ASPM_DYM_CTRL_SUPPORT
	bool "Pcie Aspm Dynamic Control Support"
	depends on MTK_APSOC_WIFI_MT_AP_SUPPORT
	default y

config MTK_APSOC_WIFI_COEX_SUPPORT
	bool "Coex Support"
	depends on MTK_APSOC_WIFI_MT_AP_SUPPORT
	default n

config MTK_APSOC_WIFI_EASY_SETUP_SUPPORT
	bool "Whole Home Coverage - Easy Setup"
	depends on MTK_APSOC_WIFI_MT_AP_SUPPORT
	default n

config MTK_APSOC_WIFI_EVENT_NOTIFIER_SUPPORT
	bool "Whole Home Coverage - Event Notifier"
	depends on MTK_APSOC_WIFI_MT_AP_SUPPORT
	default n

config MTK_APSOC_WIFI_AIR_MONITOR
	bool "Air Monitor"
	depends on MTK_APSOC_WIFI_MT_AP_SUPPORT
	default n

config MTK_APSOC_WIFI_WNM_SUPPORT
	bool "802.11v WNM Support"
	depends on MTK_APSOC_WIFI_MT_AP_SUPPORT
	default y

config MTK_APSOC_WIFI_INTERWORKING
	bool "802.11u Interworking"
	depends on MTK_APSOC_WIFI_MT_AP_SUPPORT
	default n

#config MTK_APSOC_WIFI_ROAMING_ENHANCE_SUPPORT
#	bool "Roaming Enhance Support"
#	depends on MTK_APSOC_WIFI_MT_AP_SUPPORT
#	depends on MTK_APSOC_WIFI_APCLI_SUPPORT
#	default n

config MTK_APSOC_WIFI_LINUX_NET_TXQ_SUPPORT
	bool "NET TX Queue Support"
	default y

#config MTK_APSOC_WIFI_WIFI_FWD_SUPPORT
#        bool "WiFi Forwarding Support"
#        default n

config  MTK_APSOC_WIFI_WPA3_SUPPORT
	bool "WPA3 Support"
	depends on MTK_APSOC_WIFI_MT_AP_SUPPORT
	default n

config  MTK_APSOC_WIFI_OWE_SUPPORT
	bool "Enhanced Open Support"
	depends on MTK_APSOC_WIFI_MT_AP_SUPPORT
	default n

config  MTK_APSOC_WIFI_SINGLE_SKU
	bool "Single SKU Support"
	depends on MTK_APSOC_WIFI_MT_AP_SUPPORT
	default n

endmenu

endif

config MTK_APSOC_WIFI_WIFI_MT_MAC
	bool
	default y
	depends on MTK_APSOC_WIFI_MT_WIFI

if MTK_APSOC_WIFI_WIFI_RTMP_MAC
	config MTK_APSOC_WIFI_RTMP_MAC
		bool
		default y
endif

if MTK_APSOC_WIFI_WIFI_MT_MAC
	config MTK_APSOC_WIFI_MT_MAC
		bool
		default y

	config MTK_APSOC_WIFI_CHIP_MT7603E
		bool
		default n

	config MTK_APSOC_WIFI_CHIP_MT7615E
		bool
		default n

	config MTK_APSOC_WIFI_CHIP_MT7622
		bool
		default n

	config MTK_APSOC_WIFI_CHIP_MT7663E
		bool
		default n

	config MTK_APSOC_WIFI_CHIP_MT7626
		bool
		default n

	config MTK_APSOC_WIFI_CHIP_MT7915
		bool
		default n
endif

if MTK_APSOC_WIFI_CHIP_MT7622
	config MTK_APSOC_WIFI_MT_MAC
		bool
		default y
		select MTK_APSOC_WIFI_RATE_ADAPTION
		select MTK_APSOC_WIFI_RATE_ADAPT_AGBS_SUPPORT
		select MTK_APSOC_WIFI_DOT11_N_SUPPORT
		select MTK_APSOC_WIFI_DOT11_VHT_AC
		select MTK_APSOC_WIFI_HDR_TRANS_TX_SUPPORT
		select MTK_APSOC_WIFI_HDR_TRANS_RX_SUPPORT
endif

endif #MTK_APSOC_WIFI_WIFI_DRIVER#
endif #PACKAGE_kmod-mt7622#
```
