// SPDX-License-Identifier: GPL-2.0-or-later OR MIT

/dts-v1/;

#include "ipq6010-tplink.dtsi"

/ {
	model = "TP-Link EAP625-Outdoor HD v1";
	compatible = "tplink,eap625od-hd-v1", "qcom,ipq6018";
};

&wifi {
	status = "okay";
	qcom,ath11k-fw-memory-mode = <1>;
	qcom,ath11k-calibration-variant = "TP-Link-EAP625-Outdoor-HD-v1";
};
