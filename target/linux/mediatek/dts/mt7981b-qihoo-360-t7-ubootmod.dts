// SPDX-License-Identifier: GPL-2.0-or-later OR MIT

/dts-v1/;
#include "mt7981-qihoo-360-t7.dtsi"

/ {
	model = "Qihoo 360 T7 (modified U-Boot layout)";
	compatible = "qihoo,360-t7-ubootmod", "mediatek,mt7981";
};

&partitions {
	partition@580000 {
		label = "ubi";
		reg = <0x580000 0x6c00000>;
	};
};
