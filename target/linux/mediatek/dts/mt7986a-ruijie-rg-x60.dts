// SPDX-License-Identifier: GPL-2.0-or-later OR MIT

#include "mt7986a-ruijie-rg-x60-stock.dts"
#include "mt7986a-ruijie-rg-x60-openwrt.dtsi"

/ {
	model = "Ruijie RG-X60 (OpenWrt U-Boot Layout)";
	compatible = "ruijie,rg-x60-openwrt", "mediatek,mt7986a";
};
