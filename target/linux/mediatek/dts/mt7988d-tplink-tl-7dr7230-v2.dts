// SPDX-License-Identifier: GPL-2.0-or-later OR MIT
/*
 * Copyright (C) 2025 Tianling Shen <cnsztl@immortalwrt.org>
 */

/dts-v1/;
#include "mt7988d-tplink-tl-7dr7230-v1.dts"

/ {
	model = "TP-Link TL-7DR7230 v2";
	compatible = "tplink,tl-7dr7230-v2", "mediatek,mt7988d";
};
