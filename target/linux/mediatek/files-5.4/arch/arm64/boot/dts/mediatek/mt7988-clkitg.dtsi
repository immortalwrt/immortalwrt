/*
 * Copyright (c) 2022 MediaTek Inc.
 * Author: Author: Xiufeng Li <Xiufeng.Li@mediatek.com>
 *
 * This program is free software; you can redistribute it and/or modify
 * it under the terms of the GNU General Public License version 2 as
 * published by the Free Software Foundation.
 *
 * This program is distributed in the hope that it will be useful,
 * but WITHOUT ANY WARRANTY; without even the implied warranty of
 * MERCHANTABILITY or FITNESS FOR A PARTICULAR PURPOSE.  See the
 * GNU General Public License for more details.
 */

&clkitg {
	bring-up {
		compatible = "mediatek,clk-bring-up";
		clocks =
			<&apmixedsys CK_APMIXED_NETSYSPLL>,
			<&apmixedsys CK_APMIXED_MPLL>,
			<&apmixedsys CK_APMIXED_MMPLL>,
			<&apmixedsys CK_APMIXED_APLL2>,
			<&apmixedsys CK_APMIXED_NET1PLL>,
			<&apmixedsys CK_APMIXED_NET2PLL>,
			<&apmixedsys CK_APMIXED_WEDMCUPLL>,
			<&apmixedsys CK_APMIXED_SGMPLL>,
			<&apmixedsys CK_APMIXED_ARM_B>,
			<&apmixedsys CK_APMIXED_CCIPLL2_B>,
			<&apmixedsys CK_APMIXED_USXGMIIPLL>,
			<&apmixedsys CK_APMIXED_MSDCPLL>,
			<&topckgen CK_TOP_CB_CKSQ_40M>,
			<&topckgen CK_TOP_CB_M_416M>,
			<&topckgen CK_TOP_CB_M_D2>,
			<&topckgen CK_TOP_M_D3_D2>,
			<&topckgen CK_TOP_CB_M_D4>,
			<&topckgen CK_TOP_CB_M_D8>,
			<&topckgen CK_TOP_M_D8_D2>,
			<&topckgen CK_TOP_CB_MM_720M>,
			<&topckgen CK_TOP_CB_MM_D2>,
			<&topckgen CK_TOP_CB_MM_D3_D5>,
			<&topckgen CK_TOP_CB_MM_D4>,
			<&topckgen CK_TOP_MM_D6_D2>,
			<&topckgen CK_TOP_CB_MM_D8>,
			<&topckgen CK_TOP_CB_APLL2_196M>,
			<&topckgen CK_TOP_CB_APLL2_D4>,
			<&topckgen CK_TOP_CB_NET1_D4>,
			<&topckgen CK_TOP_CB_NET1_D5>,
			<&topckgen CK_TOP_NET1_D5_D2>,
			<&topckgen CK_TOP_NET1_D5_D4>,
			<&topckgen CK_TOP_CB_NET1_D8>,
			<&topckgen CK_TOP_NET1_D8_D2>,
			<&topckgen CK_TOP_NET1_D8_D4>,
			<&topckgen CK_TOP_NET1_D8_D8>,
			<&topckgen CK_TOP_NET1_D8_D16>,
			<&topckgen CK_TOP_CB_NET2_800M>,
			<&topckgen CK_TOP_CB_NET2_D2>,
			<&topckgen CK_TOP_CB_NET2_D4>,
			<&topckgen CK_TOP_NET2_D4_D4>,
			<&topckgen CK_TOP_NET2_D4_D8>,
			<&topckgen CK_TOP_CB_NET2_D6>,
			<&topckgen CK_TOP_CB_NET2_D8>,
			<&topckgen CK_TOP_CB_WEDMCU_208M>,
			<&topckgen CK_TOP_CB_SGM_325M>,
			<&topckgen CK_TOP_CB_NETSYS_850M>,
			<&topckgen CK_TOP_CB_MSDC_400M>,
			<&topckgen CK_TOP_CKSQ_40M_D2>,
			<&topckgen CK_TOP_CB_RTC_32K>,
			<&topckgen CK_TOP_CB_RTC_32P7K>,
			<&topckgen CK_TOP_INFRA_F32K>,
			<&topckgen CK_TOP_CKSQ_SRC>,
			<&topckgen CK_TOP_NETSYS_2X>,
			<&topckgen CK_TOP_NETSYS_GSW>,
			<&topckgen CK_TOP_NETSYS_WED_MCU>,
			<&topckgen CK_TOP_EIP197>,
			<&topckgen CK_TOP_EMMC_250M>,
			<&topckgen CK_TOP_EMMC_400M>,
			<&topckgen CK_TOP_SPI>,
			<&topckgen CK_TOP_SPIM_MST>,
			<&topckgen CK_TOP_NFI1X>,
			<&topckgen CK_TOP_SPINFI_BCK>,
			<&topckgen CK_TOP_I2C_BCK>,
			<&topckgen CK_TOP_USB_SYS>,
			<&topckgen CK_TOP_USB_SYS_P1>,
			<&topckgen CK_TOP_USB_XHCI>,
			<&topckgen CK_TOP_USB_XHCI_P1>,
			<&topckgen CK_TOP_USB_FRMCNT>,
			<&topckgen CK_TOP_USB_FRMCNT_P1>,
			<&topckgen CK_TOP_AUD>,
			<&topckgen CK_TOP_A1SYS>,
			<&topckgen CK_TOP_AUD_L>,
			<&topckgen CK_TOP_A_TUNER>,
			<&topckgen CK_TOP_SYSAXI>,
			<&topckgen CK_TOP_INFRA_F26M>,
			<&topckgen CK_TOP_USB_REF>,
			<&topckgen CK_TOP_USB_CK_P1>,
			<&topckgen CK_TOP_AUD_I2S_M>,
			<&topckgen CK_TOP_NETSYS_SEL>,
			<&topckgen CK_TOP_NETSYS_500M_SEL>,
			<&topckgen CK_TOP_NETSYS_2X_SEL>,
			<&topckgen CK_TOP_NETSYS_GSW_SEL>,
			<&topckgen CK_TOP_ETH_GMII_SEL>,
			<&topckgen CK_TOP_NETSYS_MCU_SEL>,
			<&topckgen CK_TOP_NETSYS_PAO_2X_SEL>,
			<&topckgen CK_TOP_EIP197_SEL>,
			<&topckgen CK_TOP_AXI_INFRA_SEL>,
			<&topckgen CK_TOP_UART_SEL>,
			<&topckgen CK_TOP_EMMC_250M_SEL>,
			<&topckgen CK_TOP_EMMC_400M_SEL>,
			<&topckgen CK_TOP_SPI_SEL>,
			<&topckgen CK_TOP_SPIM_MST_SEL>,
			<&topckgen CK_TOP_NFI1X_SEL>,
			<&topckgen CK_TOP_SPINFI_SEL>,
			<&topckgen CK_TOP_PWM_SEL>,
			<&topckgen CK_TOP_I2C_SEL>,
			<&topckgen CK_TOP_PCIE_MBIST_250M_SEL>,
			<&system_clk>,
			<&system_clk>,
			<&system_clk>,
			<&system_clk>,
			<&topckgen CK_TOP_USB_SYS_SEL>,
			<&topckgen CK_TOP_USB_SYS_P1_SEL>,
			<&topckgen CK_TOP_USB_XHCI_SEL>,
			<&topckgen CK_TOP_USB_XHCI_P1_SEL>,
			<&topckgen CK_TOP_USB_FRMCNT_SEL>,
			<&topckgen CK_TOP_USB_FRMCNT_P1_SEL>,
			<&topckgen CK_TOP_AUD_SEL>,
			<&topckgen CK_TOP_A1SYS_SEL>,
			<&topckgen CK_TOP_AUD_L_SEL>,
			<&topckgen CK_TOP_A_TUNER_SEL>,
			<&topckgen CK_TOP_SSPXTP_SEL>,
			<&topckgen CK_TOP_USB_PHY_SEL>,
			<&topckgen CK_TOP_USXGMII_SBUS_0_SEL>,
			<&topckgen CK_TOP_USXGMII_SBUS_1_SEL>,
			<&topckgen CK_TOP_SGM_0_SEL>,
			<&topckgen CK_TOP_SGM_SBUS_0_SEL>,
			<&topckgen CK_TOP_SGM_1_SEL>,
			<&topckgen CK_TOP_SGM_SBUS_1_SEL>,
			<&topckgen CK_TOP_XFI_PHY_0_XTAL_SEL>,
			<&topckgen CK_TOP_XFI_PHY_1_XTAL_SEL>,
			<&topckgen CK_TOP_SYSAXI_SEL>,
			<&topckgen CK_TOP_SYSAPB_SEL>,
			<&topckgen CK_TOP_ETH_REFCK_50M_SEL>,
			<&topckgen CK_TOP_ETH_SYS_200M_SEL>,
			<&topckgen CK_TOP_ETH_SYS_SEL>,
			<&topckgen CK_TOP_ETH_XGMII_SEL>,
			<&topckgen CK_TOP_BUS_TOPS_SEL>,
			<&topckgen CK_TOP_NPU_TOPS_SEL>,
			<&topckgen CK_TOP_DRAMC_SEL>,
			<&topckgen CK_TOP_DRAMC_MD32_SEL>,
			<&topckgen CK_TOP_INFRA_F26M_SEL>,
			<&system_clk>,
			<&system_clk>,
			<&system_clk>,
			<&system_clk>,
			<&topckgen CK_TOP_DA_XTP_GLB_P0_SEL>,
			<&topckgen CK_TOP_DA_XTP_GLB_P1_SEL>,
			<&topckgen CK_TOP_DA_XTP_GLB_P2_SEL>,
			<&topckgen CK_TOP_DA_XTP_GLB_P3_SEL>,
			<&topckgen CK_TOP_CKM_SEL>,
			<&topckgen CK_TOP_DA_SELM_XTAL_SEL>,
			<&topckgen CK_TOP_PEXTP_SEL>,
			<&topckgen CK_TOP_TOPS_P2_26M_SEL>,
			<&topckgen CK_TOP_MCUSYS_BACKUP_625M_SEL>,
			<&topckgen CK_TOP_NETSYS_SYNC_250M_SEL>,
			<&topckgen CK_TOP_MACSEC_SEL>,
			<&topckgen CK_TOP_NETSYS_TOPS_400M_SEL>,
			<&topckgen CK_TOP_NETSYS_PPEFB_250M_SEL>,
			<&topckgen CK_TOP_NETSYS_WARP_SEL>,
			<&topckgen CK_TOP_ETH_MII_SEL>,
			<&topckgen CK_TOP_CK_NPU_SEL_CM_TOPS_SEL>,
			<&infracfg CK_INFRA_CK_F26M>,
			<&infracfg CK_INFRA_PWM_O>,
			<&system_clk>,
			<&system_clk>,
			<&system_clk>,
			<&system_clk>,
			<&infracfg CK_INFRA_133M_HCK>,
			<&infracfg CK_INFRA_133M_PHCK>,
			<&infracfg CK_INFRA_66M_PHCK>,
			<&infracfg CK_INFRA_FAUD_L_O>,
			<&infracfg CK_INFRA_FAUD_AUD_O>,
			<&infracfg CK_INFRA_FAUD_EG2_O>,
			<&infracfg CK_INFRA_I2C_O>,
			<&infracfg CK_INFRA_UART_O0>,
			<&infracfg CK_INFRA_UART_O1>,
			<&infracfg CK_INFRA_UART_O2>,
			<&infracfg CK_INFRA_NFI_O>,
			<&infracfg CK_INFRA_SPINFI_O>,
			<&infracfg CK_INFRA_SPI0_O>,
			<&infracfg CK_INFRA_SPI1_O>,
			<&infracfg CK_INFRA_LB_MUX_FRTC>,
			<&infracfg CK_INFRA_FRTC>,
			<&infracfg CK_INFRA_FMSDC400_O>,
			<&infracfg CK_INFRA_FMSDC2_HCK_OCC>,
			<&infracfg CK_INFRA_PERI_133M>,
			<&infracfg CK_INFRA_USB_O>,
			<&infracfg CK_INFRA_USB_O_P1>,
			<&infracfg CK_INFRA_USB_FRMCNT_O>,
			<&infracfg CK_INFRA_USB_FRMCNT_O_P1>,
			<&infracfg CK_INFRA_USB_XHCI_O>,
			<&infracfg CK_INFRA_USB_XHCI_O_P1>,
			<&infracfg CK_INFRA_USB_PIPE_O>,
			<&infracfg CK_INFRA_USB_PIPE_O_P1>,
			<&infracfg CK_INFRA_USB_UTMI_O>,
			<&infracfg CK_INFRA_USB_UTMI_O_P1>,
			<&system_clk>,
			<&system_clk>,
			<&system_clk>,
			<&system_clk>,
			<&infracfg CK_INFRA_F26M_O0>,
			<&infracfg CK_INFRA_F26M_O1>,
			<&infracfg CK_INFRA_133M_MCK>,
			<&infracfg CK_INFRA_66M_MCK>,
			<&infracfg CK_INFRA_PERI_66M_O>,
			<&infracfg CK_INFRA_USB_SYS_O>,
			<&infracfg CK_INFRA_USB_SYS_O_P1>,
			<&infracfg_ao CK_INFRA_66M_GPT_BCK>,
			<&infracfg_ao CK_INFRA_66M_PWM_HCK>,
			<&infracfg_ao CK_INFRA_66M_PWM_BCK>,
			<&infracfg_ao CK_INFRA_66M_PWM_CK1>,
			<&infracfg_ao CK_INFRA_66M_PWM_CK2>,
			<&infracfg_ao CK_INFRA_66M_PWM_CK3>,
			<&infracfg_ao CK_INFRA_66M_PWM_CK4>,
			<&infracfg_ao CK_INFRA_66M_PWM_CK5>,
			<&infracfg_ao CK_INFRA_66M_PWM_CK6>,
			<&infracfg_ao CK_INFRA_66M_PWM_CK7>,
			<&infracfg_ao CK_INFRA_66M_PWM_CK8>,
			<&infracfg_ao CK_INFRA_133M_CQDMA_BCK>,
			<&infracfg_ao CK_INFRA_66M_AUD_SLV_BCK>,
			<&infracfg_ao CK_INFRA_AUD_26M>,
			<&infracfg_ao CK_INFRA_AUD_L>,
			<&infracfg_ao CK_INFRA_AUD_AUD>,
			<&infracfg_ao CK_INFRA_AUD_EG2>,
			<&infracfg_ao CK_INFRA_DRAMC_F26M>,
			<&infracfg_ao CK_INFRA_133M_DBG_ACKM>,
			<&infracfg_ao CK_INFRA_66M_AP_DMA_BCK>,
			<&infracfg_ao CK_INFRA_66M_SEJ_BCK>,
			<&infracfg_ao CK_INFRA_PRE_CK_SEJ_F13M>,
			<&infracfg_ao CK_INFRA_66M_TRNG>,
			<&infracfg_ao CK_INFRA_26M_THERM_SYSTEM>,
			<&infracfg_ao CK_INFRA_I2C_BCK>,
			<&infracfg_ao CK_INFRA_66M_UART0_PCK>,
			<&infracfg_ao CK_INFRA_66M_UART1_PCK>,
			<&infracfg_ao CK_INFRA_66M_UART2_PCK>,
			<&infracfg_ao CK_INFRA_52M_UART0_CK>,
			<&infracfg_ao CK_INFRA_52M_UART1_CK>,
			<&infracfg_ao CK_INFRA_52M_UART2_CK>,
			<&infracfg_ao CK_INFRA_NFI>,
			<&infracfg_ao CK_INFRA_SPINFI>,
			<&infracfg_ao CK_INFRA_66M_NFI_HCK>,
			<&infracfg_ao CK_INFRA_104M_SPI0>,
			<&infracfg_ao CK_INFRA_104M_SPI1>,
			<&infracfg_ao CK_INFRA_104M_SPI2_BCK>,
			<&infracfg_ao CK_INFRA_66M_SPI0_HCK>,
			<&infracfg_ao CK_INFRA_66M_SPI1_HCK>,
			<&infracfg_ao CK_INFRA_66M_SPI2_HCK>,
			<&infracfg_ao CK_INFRA_66M_FLASHIF_AXI>,
			<&infracfg_ao CK_INFRA_RTC>,
			<&infracfg_ao CK_INFRA_26M_ADC_BCK>,
			<&infracfg_ao CK_INFRA_RC_ADC>,
			<&infracfg_ao CK_INFRA_MSDC400>,
			<&infracfg_ao CK_INFRA_MSDC2_HCK>,
			<&infracfg_ao CK_INFRA_133M_MSDC_0_HCK>,
			<&infracfg_ao CK_INFRA_66M_MSDC_0_HCK>,
			<&infracfg_ao CK_INFRA_133M_CPUM_BCK>,
			<&infracfg_ao CK_INFRA_BIST2FPC>,
			<&infracfg_ao CK_INFRA_I2C_X16W_MCK_CK_P1>,
			<&infracfg_ao CK_INFRA_I2C_X16W_PCK_CK_P1>,
			<&infracfg_ao CK_INFRA_133M_USB_HCK>,
			<&infracfg_ao CK_INFRA_133M_USB_HCK_CK_P1>,
			<&infracfg_ao CK_INFRA_66M_USB_HCK>,
			<&infracfg_ao CK_INFRA_66M_USB_HCK_CK_P1>,
			<&infracfg_ao CK_INFRA_USB_SYS>,
			<&infracfg_ao CK_INFRA_USB_SYS_CK_P1>,
			<&infracfg_ao CK_INFRA_USB_REF>,
			<&infracfg_ao CK_INFRA_USB_CK_P1>,
			<&infracfg_ao CK_INFRA_USB_FRMCNT>,
			<&infracfg_ao CK_INFRA_USB_FRMCNT_CK_P1>,
			<&infracfg_ao CK_INFRA_USB_PIPE>,
			<&infracfg_ao CK_INFRA_USB_PIPE_CK_P1>,
			<&infracfg_ao CK_INFRA_USB_UTMI>,
			<&infracfg_ao CK_INFRA_USB_UTMI_CK_P1>,
			<&infracfg_ao CK_INFRA_USB_XHCI>,
			<&infracfg_ao CK_INFRA_USB_XHCI_CK_P1>,
			<&system_clk>,
			<&system_clk>,
			<&system_clk>,
			<&system_clk>,
			<&system_clk>,
			<&system_clk>,
			<&system_clk>,
			<&system_clk>,
			<&system_clk>,
			<&system_clk>,
			<&system_clk>,
			<&system_clk>,
			<&system_clk>,
			<&system_clk>,
			<&system_clk>,
			<&system_clk>,
			<&infracfg_ao CK_INFRA_MUX_UART0_SEL>,
			<&infracfg_ao CK_INFRA_MUX_UART1_SEL>,
			<&infracfg_ao CK_INFRA_MUX_UART2_SEL>,
			<&infracfg_ao CK_INFRA_MUX_SPI0_SEL>,
			<&infracfg_ao CK_INFRA_MUX_SPI1_SEL>,
			<&infracfg_ao CK_INFRA_MUX_SPI2_SEL>,
			<&infracfg_ao CK_INFRA_PWM_SEL>,
			<&infracfg_ao CK_INFRA_PWM_CK1_SEL>,
			<&infracfg_ao CK_INFRA_PWM_CK2_SEL>,
			<&infracfg_ao CK_INFRA_PWM_CK3_SEL>,
			<&infracfg_ao CK_INFRA_PWM_CK4_SEL>,
			<&infracfg_ao CK_INFRA_PWM_CK5_SEL>,
			<&infracfg_ao CK_INFRA_PWM_CK6_SEL>,
			<&infracfg_ao CK_INFRA_PWM_CK7_SEL>,
			<&infracfg_ao CK_INFRA_PWM_CK8_SEL>,
			<&system_clk>,
			<&system_clk>,
			<&system_clk>,
			<&system_clk>,
			<&ethsys CK_ETHDMA_XGP1_EN>,
			<&ethsys CK_ETHDMA_XGP2_EN>,
			<&ethsys CK_ETHDMA_XGP3_EN>,
			<&ethsys CK_ETHDMA_FE_EN>,
			<&ethsys CK_ETHDMA_GP2_EN>,
			<&ethsys CK_ETHDMA_GP1_EN>,
			<&ethsys CK_ETHDMA_GP3_EN>,
			<&ethsys CK_ETHDMA_ESW_EN>,
			<&ethsys CK_ETHDMA_CRYPT0_EN>,
			<&ethwarp CK_ETHWARP_WOCPU2_EN>,
			<&ethwarp CK_ETHWARP_WOCPU1_EN>,
			<&ethwarp CK_ETHWARP_WOCPU0_EN>,
			<&sgmiisys0 CK_SGM0_TX_EN>,
			<&sgmiisys0 CK_SGM0_RX_EN>,
			<&sgmiisys1 CK_SGM1_TX_EN>,
			<&sgmiisys1 CK_SGM1_RX_EN>,
			<&mcusys CK_MCU_BUS_DIV_SEL>,
			<&mcusys CK_MCU_ARM_DIV_SEL>;

		clock-names = "0", "1", "2", "3", "4", "5", "6", "7", "8", "9",
			      "10", "11", "12", "13", "14", "15", "16", "17",
			      "18", "19", "20", "21", "22", "23", "24", "25",
			      "26", "27", "28", "29", "30", "31", "32", "33",
			      "34", "35", "36", "37", "38", "39", "40", "41",
			      "42", "43", "44", "45", "46", "47", "48", "49",
			      "50", "51", "52", "53", "54", "55", "56", "57",
			      "58", "59", "60", "61", "62", "63", "64", "65",
			      "66", "67", "68", "69", "70", "71", "72", "73",
			      "74", "75", "76", "77", "78", "79", "80", "81",
			      "82", "83", "84", "85", "86", "87", "88", "89",
			      "90", "91", "92", "93", "94", "95", "96", "97",
			      "98", "99", "100", "101", "102", "103", "104",
			      "105", "106", "107", "108", "109", "110", "111",
			      "112", "113", "114", "115", "116", "117", "118",
			      "119", "120", "121", "122", "123", "124", "125",
			      "126", "127", "128", "129", "130", "131", "132",
			      "133", "134", "135", "136", "137", "138", "139",
			      "140", "141", "142", "143", "144", "145", "146",
			      "147", "148", "149", "150", "151", "152", "153",
			      "154", "155", "156", "157", "158", "159", "160",
			      "161", "162", "163", "164", "165", "166", "167",
			      "168", "169", "170", "171", "172", "173", "174",
			      "175", "176", "177", "178", "179", "180", "181",
			      "182", "183", "184", "185", "186", "187", "188",
			      "189", "190", "191", "192", "193", "194", "195",
			      "196", "197", "198", "199", "200", "201", "202",
			      "203", "204", "205", "206", "207", "208", "209",
			      "210", "211", "212", "213", "214", "215", "216",
			      "217", "218", "219", "220", "221", "222", "223",
			      "224", "225", "226", "227", "228", "229", "230",
			      "231", "232", "233", "234", "235", "236", "237",
			      "238", "239", "240", "241", "242", "243", "244",
			      "245", "246", "247", "248", "249", "250", "251",
			      "252", "253", "254", "255", "256", "257", "258",
			      "259", "260", "261", "262", "263", "264", "265",
			      "266", "267", "268", "269", "270", "271", "272",
			      "273", "274", "275", "276", "277", "278", "279",
			      "280", "281", "282", "283", "284", "285", "286",
			      "287", "288", "289", "290", "291", "292", "293",
			      "294", "295", "296", "297", "298", "299", "300",
			      "301", "302", "303", "304", "305", "306", "307",
			      "308", "309", "310", "311", "312", "313", "314",
			      "315", "316", "317", "318", "319", "320", "321",
			      "322", "323";
	};
};

