// SPDX-License-Identifier: GPL-2.0-or-later OR MIT
/*
 * Copyright (c) 2022 AmadeusGhost <amadeus@jmu.edu.cn>
 */

/dts-v1/;

#include "rk3568-opc-h66k.dtsi"

/ {
	model = "Hinlink OPC-H66K";
	compatible = "hinlink,opc-h66k", "rockchip,rk3568";
};

&vcc3v3_pcie {
	gpio = <&gpio0 RK_PC4 GPIO_ACTIVE_HIGH>;
};
