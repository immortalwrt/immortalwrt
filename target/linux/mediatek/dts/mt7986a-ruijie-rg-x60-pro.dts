// SPDX-License-Identifier: GPL-2.0-or-later OR MIT

#include "mt7986a-ruijie-rg-x60-pro-stock.dts"
#include "mt7986a-ruijie-rg-x60-openwrt.dtsi"

/ {
	model = "Ruijie RG-X60 Pro (OpenWrt U-Boot Layout)";
	compatible = "ruijie,rg-x60-pro-openwrt", "mediatek,mt7986a";
};
