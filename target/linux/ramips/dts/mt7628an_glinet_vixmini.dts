// SPDX-License-Identifier: GPL-2.0-or-later OR MIT
/dts-v1/;

#include "mt7628an_glinet_vixmini_microuter.dtsi"

/ {
	compatible = "glinet,vixmini", "mediatek,mt7628an-soc";
	model = "GL.iNet VIXMINI";
};

&firmware_part {
		reg = <0x50000 0x7b0000>;
};
