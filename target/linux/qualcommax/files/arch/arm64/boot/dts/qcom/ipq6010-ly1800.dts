// SPDX-License-Identifier: GPL-2.0-or-later OR MIT

/dts-v1/;

#include "ipq6010-philips.dtsi"

/ {
	model = "Philips LY1800";
	compatible = "philips,ly1800", "qcom,ipq6018";
};

&wifi {
	status = "okay";
	qcom,ath11k-fw-memory-mode = <1>;
	qcom,ath11k-calibration-variant = "Philips-LY1800";
};
