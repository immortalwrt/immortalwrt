// SPDX-License-Identifier: GPL-2.0-or-later OR MIT

/dts-v1/;

#include "ipq8074.dtsi"
#include "ipq8174-mx4200.dtsi"

/ {
	model = "Linksys MX4200v1";
	compatible = "linksys,mx4200v1", "qcom,ipq8074";

	aliases {
		ethernet1 = &dp2;
		ethernet2 = &dp3;
		ethernet3 = &dp4;
		ethernet4 = &dp5;
	};
};

&wifi {
	status = "okay";
	qcom,ath11k-fw-memory-mode = <1>;
	qcom,ath11k-calibration-variant = "Linksys-MX4200v1";
};
