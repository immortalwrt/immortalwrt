// SPDX-License-Identifier: GPL-2.0-or-later OR MIT

/dts-v1/;

#include "ipq6000-xiaomi.dtsi"

/ {
	model = "Xiaomi AX1800";
	compatible = "xiaomi,ax1800", "qcom,ipq6018";
};

&wifi {
	status = "okay";
	qcom,ath11k-fw-memory-mode = <1>;
	qcom,ath11k-calibration-variant = "Xiaomi-AX1800";
};
