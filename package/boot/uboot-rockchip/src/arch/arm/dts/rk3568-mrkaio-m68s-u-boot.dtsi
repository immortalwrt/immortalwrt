// SPDX-License-Identifier: GPL-2.0-or-later OR MIT

#include "rk356x-u-boot.dtsi"

&vcc5v0_usb_host {
	/delete-property/ regulator-always-on;
	/delete-property/ regulator-boot-on;
};

&vcc5v0_usb_otg {
	/delete-property/ regulator-always-on;
	/delete-property/ regulator-boot-on;
};
