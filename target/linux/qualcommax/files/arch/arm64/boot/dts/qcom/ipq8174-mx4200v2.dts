// SPDX-License-Identifier: GPL-2.0-or-later OR MIT

/dts-v1/;

#include "ipq8174-mx4200.dtsi"

/ {
	model = "Linksys MX4200v2";
	compatible = "linksys,mx4200v2", "qcom,ipq8074";
};

&wifi {
	status = "okay";
	qcom,ath11k-fw-memory-mode = <1>;
	qcom,ath11k-calibration-variant = "Linksys-MX4200v2";
};
