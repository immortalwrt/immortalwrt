// SPDX-License-Identifier: GPL-2.0-or-later OR MIT

#include "qcom-ipq4019-r619ac.dtsi"

/ {
	model = "P&W R619AC PCIE";
	compatible = "p2w,r619ac-pcie";

	chosen {
		bootargs-append = " root=/dev/ubiblock0_1 rootfstype=squashfs";
	};
};

&pcie0 {
	status = "okay";
	perst-gpio = <&tlmm 4 GPIO_ACTIVE_LOW>;
	wake-gpio = <&tlmm 40 GPIO_ACTIVE_HIGH>;

	/* Free slot for use */
	bridge@0,0 {
		reg = <0x00000000 0 0 0 0>;
		#address-cells = <3>;
		#size-cells = <2>;
		ranges;
	};
};
