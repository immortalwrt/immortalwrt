// SPDX-License-Identifier: BSD-3-Clause
/*
 *  Copyright(c) 2017 Kristian Evensen <kristian.evensen@gmail.com>.
 *  Copyright(c) 2017 Piotr Dymacz <pepe2k@gmail.com>.
 *  All rights reserved.
 */

#include "mt7621_ws7915.dtsi"

/ {
	compatible = "huasifei,ws7915-32", "huasifei,ws7915-32", "mediatek,mt7621-soc";
	model = "Huasifei,ws7915-32";
};

&firmware {
	reg = <0x50000 0x1fb0000>;
};