## package/mtk/drivers/mt_wifi/src/mt_wifi_ap/Kconfig
```kconfig
config MT_AP_SUPPORT
	tristate "MTK AP support"
#	depends on NET_RADIO
	select WIRELESS_EXT
	select WEXT_SPY
	select WEXT_PRIV

config WDS_SUPPORT
	bool "WDS"
	depends on MT_AP_SUPPORT
	default y

config WIFI_EAP_FEATURE
	bool "EAP Feature"
	depends on MT_AP_SUPPORT
	default y

config VLAN_SUPPORT
	bool "VLAN support"
	depends on WIFI_EAP_FEATURE
	default n

config TXRX_STAT_SUPPORT
	bool "TxRx Stats Support"
	depends on WIFI_EAP_FEATURE
	default n

config SNIFFER_SUPPORT
	bool "SNIFFER"
	depends on WIFI_EAP_FEATURE
	default n

config ANTENNA_CONTROL_SUPPORT
	bool "Antenna Control Support"
	depends on WIFI_EAP_FEATURE
	default n

config MGMT_TXPWR_CTRL
	bool "Mgmt TxPower Control"
	depends on WIFI_EAP_FEATURE
	default n

config RA_PHY_RATE_SUPPORT
	bool "RA PHY RATE Support"
	depends on WIFI_EAP_FEATURE
	default n

config AMPDU_CONF_SUPPORT
	bool "AMPDU Config retry & agglimit Support"
	depends on WIFI_EAP_FEATURE
	default n

config ACK_CTS_TIMEOUT_SUPPORT
	bool "ACK CTS Timeout cck & ofdm Support"
	depends on WIFI_EAP_FEATURE
	default n

config MBSS_SUPPORT
	bool "MBSSID"
	depends on MT_AP_SUPPORT
	default y

#config NEW_MBSSID_MODE
#	bool "New MBSSID MODE"
#	depends on MT_AP_SUPPORT && MBSS_SUPPORT
#	depends on RALINK_RT3883 || RALINK_RT3352 || RALINK_RT5350 || RALINK_RT6352 || RALINK_MT7620
#	default y

#config ENHANCE_NEW_MBSSID_MODE
#	bool "Enhanced MBSSID mode"
#	depends on NEW_MBSSID_MODE
#	default y

config APCLI_SUPPORT
	bool "AP-Client Support"
	depends on MT_AP_SUPPORT
	default y

config APCLI_CERT_SUPPORT
	bool "AP-Client TGn Cert Support"
	depends on MT_AP_SUPPORT
	depends on APCLI_SUPPORT
	default n

config MAC_REPEATER_SUPPORT
	bool "MAC Repeater Support"
	depends on MT_AP_SUPPORT
	depends on APCLI_SUPPORT
	depends on RALINK_RT6352 || RALINK_MT7620 || RALINK_MT7603E || MT_AP_SUPPORT
	default y

config MWDS
    bool "Mixed WDS(MWDS)"
    depends on CHIP_MT7615E || CHIP_MT7915
    depends on MT_AP_SUPPORT
    select APCLI_SUPPORT
    default n

config WIFI_SYSTEM_DVT
    bool "Wifi system dvt Support"
    depends on MT_AP_SUPPORT
    default y

config MUMIMO_SUPPORT
	bool "MU-MIMO Support"
	depends on WIFI_DRIVER
	select MU_RA_SUPPORT
	default y

config MU_RA_SUPPORT
  	bool "MU-RGA Support"
  	depends on MUMIMO_SUPPORT
  	
config DOT11R_FT_SUPPORT
	bool "802.11r Fast BSS Transition"
	depends on MT_AP_SUPPORT
	default n

config DOT11K_RRM_SUPPORT
	bool "802.11k Radio Resource Management"
	depends on MT_AP_SUPPORT
	default n

config KVRH_SUPPORT
	bool "Query STA 802.11k/v/r/h Capability"
	depends on MT_AP_SUPPORT
	default n
config INTERWORKING
	bool "802.11u Interworking/Gas Support"
        depends on MT_AP_SUPPORT
        default n

config MAP_SUPPORT
	bool "Multi-AP Support"
	depends on MT_AP_SUPPORT
	#select MBO_SUPPORT
	select WAPP_SUPPORT
	default n

config MAP_R2_VER_SUPPORT
	bool "Multi-AP R2 version support"
	depends on MT_AP_SUPPORT
	depends on MAP_SUPPORT
	default n

#config MAP_R3_VER_SUPPORT
#	bool "Multi-AP R3 version support"
#	depends on MT_AP_SUPPORT
#	depends on MAP_SUPPORT
#	depends on MAP_R2_VER_SUPPORT
#	default n

config QOS_R1_SUPPORT
	bool "MTK QoS R1 support"
	default n

config BS_SUPPORT
	bool "Bandsteering 2.0 Support"
	depends on MT_AP_SUPPORT
	#select MBO_SUPPORT
	select WAPP_SUPPORT
	default n

config OFFCHANNEL_SCAN_FEATURE
        bool "Channel Quality Monitor"
        depends on MT_AP_SUPPORT
        default n

config WAPP_SUPPORT
	bool "WAPP Support"
	depends on MT_AP_SUPPORT
        select INTERWORKING
        select WNM_SUPPORT
        select DOT11K_RRM_SUPPORT
        select DOT11R_FT_SUPPORT
        select DOT11W_PMF_SUPPORT
	default n

config OCE_SUPPORT
        bool "Optimized Connectivity Experience Support"
	depends on MT_AP_SUPPORT
	depends on MBO_SUPPORT
	depends on CHIP_MT7915 || CHIP_MT7986 || CHIP_MT7916 || CHIP_MT7981
	select WAPP_SUPPORT
	default y

#config DPP_FEATURE
#        bool "DPP Support"
#        depends on MT_AP_SUPPORT
#	depends on WIFI_DRIVER
#        default n
config WIFI_MSI_SUPPORT
        bool "MSI support"
        depends on PCI_MSI
        depends on CHIP_MT7615E
        default n

config CFG80211_SUPPORT
	bool "CFG80211"
	depends on MT_AP_SUPPORT
	default n

#CUSTOMISED HOSTAPD
config CUSTOMISED_HOSTAPD_SUPPORT
	bool "Customised Hostapd Support"
	depends on MT_AP_SUPPORT
	depends on CFG80211_SUPPORT
	default n

# HOSTAPD WPA3
config HOSTAPD_WPA3_SUPPORT
        bool "Hostapd WPA3 Support"
        depends on MT_AP_SUPPORT
        depends on CFG80211_SUPPORT
        default n

#Support iwcommand with cfg80211
config IWCOMMAND_CFG80211_SUPPORT
	bool "Suooprt iw cfg80211 command"
	depends on CFG80211_SUPPORT
	default n

config ENTERPRISE_AP_SUPPORT
	bool "Enterprise AP Support"
	depends on MT_AP_SUPPORT
	default n

#IAP STA DUMP
#config WIFI_IAP_STA_DUMP_FEATURE_SUPPORT
#	bool "IW command station dump for iAP/Eap feature Support"
#	depends on MT_AP_SUPPORT
#	default n

#IAP POWER SAVE
#config WIFI_IAP_POWER_SAVE_FEATURE_SUPPORT
#	bool "IW command power save set for iAP/Eap feature Support"
#	depends on MT_AP_SUPPORT
#	default n

#IAP IW SCAN
#config WIFI_IAP_IW_SCAN_FEATURE_SUPPORT
#	bool "IW command scan feature Support"
#	depends on MT_AP_SUPPORT
#	default n

#IAP IW SET CHANNEL
#config WIFI_IAP_IW_SET_CHANNEL_FEATURE_SUPPORT
#	bool "IW command set channel Support"
#	depends on MT_AP_SUPPORT
#	default n

config DYNAMIC_VLAN_SUPPORT
	bool "Dynamic VLAN Support"
	depends on ENTERPRISE_AP_SUPPORT
	depends on CFG80211_SUPPORT
	default n

config VLAN_GTK_SUPPORT
	bool "Per VLAN GTK Support"
	depends on ENTERPRISE_AP_SUPPORT
	depends on CFG80211_SUPPORT
	depends on DYNAMIC_VLAN_SUPPORT
	depends on IWCOMMAND_CFG80211_SUPPORT
	default n

config RADIUS_MAC_AUTH_SUPPORT
	bool "Radius Mac Authentication Support"
	depends on ENTERPRISE_AP_SUPPORT
	depends on CFG80211_SUPPORT
	default n


#APCLI STA
config APCLI_STA_SUPPORT
	bool "APCLI CFG80211 STA Support"
	depends on APCLI_SUPPORT
	depends on CFG80211_SUPPORT
        depends on ENTERPRISE_AP_SUPPORT
	default n

#WDS STA
config WDS_STA_SUPPORT
	bool "WDS STA Support"
	depends on APCLI_SUPPORT
	depends on CFG80211_SUPPORT
        depends on ENTERPRISE_AP_SUPPORT
	default n

#WDS AP
config MBSS_AS_WDS_AP_SUPPORT
	bool "MBSS AS WDS AP Support"
	depends on MT_AP_SUPPORT
	depends on MBSS_SUPPORT
        depends on ENTERPRISE_AP_SUPPORT
	default n

#config DSCP_PRI_SUPPORT
#	bool "Dscp Priority Mapping Support
#	depends on MT_AP_SUPPORT
#	default n

config DSCP_PRI_SUPPORT
	bool "Dscp Priority Mapping Support"
	depends on MT_AP_SUPPORT
	default n

config CON_WPS_SUPPORT
	bool "Concurrent WPS Support"
	depends on MT_AP_SUPPORT
	depends on APCLI_SUPPORT
	depends on WSC_INCLUDED
	depends on WSC_V2_SUPPORT
#	depends on MULTI_INF_SUPPORT
	default n
	
#config LLTD_SUPPORT
#	bool "LLTD (Link Layer Topology Discovery Protocol)"
#	depends on MT_AP_SUPPORT

#config COC_SUPPORT
#	bool "CoC Support"
#	depends on MT_AP_SUPPORT
#	default n

#config  RT2860V2_SNMP
#	bool "Net-SNMP Support"
#	depends on MT_AP_SUPPORT

config MCAST_RATE_SPECIFIC
	bool "User specific tx rate of mcast pkt"
	depends on MT_AP_SUPPORT
	default y

#config EXT_BUILD_CHANNEL_LIST
#	bool "Extension Channel List"
#	depends on MT_AP_SUPPORT

#config AUTO_CH_SELECT_ENHANCE
#	bool "Auto Channel Selection Enhancement"
#	depends on MT_AP_SUPPORT

config VOW_SUPPORT
	bool "MediaAir(VOW) support"
	depends on MT_AP_SUPPORT
	default y

#config AIRPLAY_SUPPORT
#	bool "AIRPLAY Support"
#	depends on MT_AP_SUPPORT
#	default n

config BAND_STEERING
	bool "Band Steering"
	depends on MT_AP_SUPPORT
	default y

config LED_CONTROL_SUPPORT
	bool "LED Control Support"
	default n

config WLAN_HOOK
	bool "WLAN hook Support"
	depends on WIFI_DRIVER
	default n

config RADIUS_ACCOUNTING_SUPPORT
	bool "Radius Accounting Support"
	depends on MT_AP_SUPPORT
	default n

config GREENAP_SUPPORT
	bool "GreenAP Support"
	depends on MT_AP_SUPPORT
	default y

config PCIE_ASPM_DYM_CTRL_SUPPORT
	bool "Pcie Aspm Dynamic Control Support"
	depends on MT_AP_SUPPORT
	default y

config WIFI_TWT_SUPPORT
	bool "802.11ax TWT Support"
	depends on MT_AP_SUPPORT
	default n

config COEX_SUPPORT
	bool "Coex Support"
	depends on MT_AP_SUPPORT
	default n

config EASY_SETUP_SUPPORT
	bool "Whole Home Coverage - Easy Setup"
	depends on MT_AP_SUPPORT
	depends on CHIP_MT7615E
	default n    

config EVENT_NOTIFIER_SUPPORT
	bool "Whole Home Coverage - Event Notifier"
	depends on MT_AP_SUPPORT
	depends on CHIP_MT7615E
	default n

config AIR_MONITOR
	bool "Air Monitor"
	depends on MT_AP_SUPPORT
	default n

config WNM_SUPPORT
	bool "802.11v WNM Support"
	depends on MT_AP_SUPPORT
	default n

config CUSTOMER_VENDOR_IE_SUPPORT
	bool "Customer Vendor IE support"
	depends on MT_AP_SUPPORT
	depends on CHIP_MT7663E
	default n

#config ROAMING_ENHANCE_SUPPORT
#	bool "Roaming Enhance Support"
#	depends on MT_AP_SUPPORT
#	depends on APCLI_SUPPORT
#	default n

#config WIFI_FWD_SUPPORT
#        bool "WiFi Forwarding Support"
#        default n

config WPA3_SUPPORT
        bool "WPA3 support"
        depends on MT_AP_SUPPORT
        depends on CFG80211_SUPPORT=n
        default n

config OWE_SUPPORT
	bool "Enhance OPEN(OWE) support"
	depends on MT_AP_SUPPORT
	depends on WPA3_SUPPORT
	default n

config RCSA_SUPPORT
	bool "Reverse-CSA"
	depends on WIFI_DRIVER
	depends on MT_DFS_SUPPORT
	depends on APCLI_SUPPORT
	default n

config SINGLE_SKU
        bool "SKU(Single Sku) support"
        depends on WIFI_DRIVER
        default y

config PROFILING_SUPPORT
	bool "WIFI Profiling Support"
	default n

config MLME_MULTI_QUEUE_SUPPORT
	bool "Mlme Multi Queue Support"
	default n

config WIFI_CSI_CN_INFO_SUPPORT
	bool "CSI CN Info Support"
	depends on MT_AP_SUPPORT
	default n

#config DBG_ENHANCE
#	bool "DBG enhanced"
#	default n

#config WIFI_DIAG
#	bool "CTC WIFI diagnose feature support"
#	depends on MT_AP_SUPPORT
#	default y

#config CONN_FAIL_EVENT
#	bool "CTC WIFI connection fail event feature support"
#	depends on MT_AP_SUPPORT
#	default y
#
#config GNAX_ONLY_SUPPORT
#	bool "GNAX Only mode, 11B not allowed"
#	default n
```

## package/mtk/drivers/warp/config.in
```kconfig
if PACKAGE_kmod-warp

config WARP_VERSION
	int "WARP Driver HW Version Support"
	range 1 3
	default 1 if TARGET_mediatek_mt7622
	default 2 if TARGET_mediatek_mt7986
	default 3 if TARGET_mediatek_mt7988

config WARP_ATC_SUPPORT
	bool "WARP Driver Address Translate Support for CR mirror"
	default n

config WARP_DBG_SUPPORT
	bool "WARP Driver Debug Info Support"
	default y

config WARP_WDMA_RECYCLE_SUPPORT
	bool "WARP WDMA Recycle Support"
	default n

config WED_HW_RRO_SUPPORT
	bool "WED HW RRO Support"
	default y

config MTK_MEMORY_SHRINK
	bool "Memory Shrink"
	default n

config WARP_MEMORY_LEAK_DBG
	bool "Memory leak debug"
	depends on !MTK_MEMORY_SHRINK && WARP_DBG_SUPPORT
	default y

config WARP_CHIPSET
	string "WARP target chipset"
	default mt7988
	help
	For colgin: colgin, for panther: mt7986, for jaguar: mt7988

config WARP_WO_EMBEDDED_LOAD
	bool "Emebedded MCU firmware support"
	default n
	help
	Once enabled, firmware download flow try embedded version once externel version being invalid.

config WARP_NEW_FW
	bool "Use new warp firmware"
	default n
endif
```

## target/linux/generic/files-5.4/drivers/mtd/nmbm/Kconfig
```kconfig
config NMBM
	bool "Enable NAND mapping block management"
	default n
	select CRC32

choice
	prompt "Default log level"
	depends on NMBM
	default NMBM_LOG_LEVEL_INFO

config NMBM_LOG_LEVEL_DEBUG
	bool "0 - Debug"

config NMBM_LOG_LEVEL_INFO
	bool "1 - Info"

config NMBM_LOG_LEVEL_WARN
	bool "2 - Warn"

config NMBM_LOG_LEVEL_ERR
	bool "3 - Error"

config NMBM_LOG_LEVEL_EMERG
	bool "4 - Emergency"

config NMBM_LOG_LEVEL_NONE
	bool "5 - None"

endchoice

config NMBM_MTD
	bool "Enable MTD based NAND mapping block management"
	default n
	depends on NMBM
```

## target/linux/mediatek/files-5.4/drivers/mtd/mtk-snand/Kconfig
```kconfig
#
# Copyright (C) 2020 MediaTek Inc. All rights reserved.
# Author: Weijie Gao <weijie.gao@mediatek.com>
#
# SPDX-License-Identifier: GPL-2.0
#

config MTK_SPI_NAND
	tristate "MediaTek SPI NAND flash controller driver"
	depends on MTD
	default n
	help
	  This option enables access to SPI-NAND flashes through the
	  MTD interface of MediaTek SPI NAND Flash Controller
```

## target/linux/mediatek/files-5.4/drivers/net/ethernet/mediatek/Kconfig
```kconfig
# SPDX-License-Identifier: GPL-2.0-only
config NET_VENDOR_MEDIATEK
	bool "MediaTek ethernet driver"
	depends on ARCH_MEDIATEK || SOC_MT7621 || SOC_MT7620
	---help---
	  If you have a Mediatek SoC with ethernet, say Y.

if NET_VENDOR_MEDIATEK

config NET_MEDIATEK_SOC
	tristate "MediaTek SoC Gigabit Ethernet support"
	select PHYLINK
	---help---
	  This driver supports the gigabit ethernet MACs in the
	  MediaTek SoC family.

config MEDIATEK_NETSYS_V2
	tristate "MediaTek Ethernet NETSYS V2 support"
	 depends on ARCH_MEDIATEK && NET_MEDIATEK_SOC
	---help---
	  This options enable MTK Ethernet NETSYS V2 support
	  
config MEDIATEK_NETSYS_RX_V2
	tristate "MediaTek Ethernet NETSYS RX_V2 support"
	 depends on ARCH_MEDIATEK && NET_MEDIATEK_SOC
	---help---
	  This options enable MTK Ethernet NETSYS RX_V2 support
	  


config NET_MEDIATEK_HNAT
	tristate "MediaTek HW NAT support"
	depends on NET_MEDIATEK_SOC && NF_CONNTRACK && IP_NF_NAT
	---help---
	  This driver supports the hardward Network Address Translation
	  in the MediaTek MT7986/MT2701/MT7622/MT7629/MT7621 chipset
	  family.

endif #NET_VENDOR_MEDIATEK
```

## target/linux/mediatek/files-5.4/drivers/thermal/mediatek/Kconfig
```kconfig
config MTK_SOC_THERMAL_LVTS
        tristate "LVTS (Low voltage thermal sensor) driver for Mediatek SoCs"
        depends on HAS_IOMEM
        depends on NVMEM
        help
          Enable this option if you want to get SoC temperature
          information for Mediatek platforms. This driver
          configures LVTS thermal controllers to collect temperatures
          via Analog Serial Interface(ASIF).
```

## target/linux/ramips/files/drivers/crypto/mtk-eip93/Kconfig
```kconfig
# SPDX-License-Identifier: GPL-2.0
config CRYPTO_DEV_EIP93_SKCIPHER
	tristate

config CRYPTO_DEV_EIP93_HMAC
	tristate

config CRYPTO_DEV_EIP93
	tristate "Support for EIP93 crypto HW accelerators"
	depends on SOC_MT7621 || COMPILE_TEST
	help
	  EIP93 have various crypto HW accelerators. Select this if
	  you want to use the EIP93 modules for any of the crypto algorithms.

if CRYPTO_DEV_EIP93

config CRYPTO_DEV_EIP93_AES
	bool "Register AES algorithm implementations with the Crypto API"
	default y
	select CRYPTO_DEV_EIP93_SKCIPHER
	select CRYPTO_LIB_AES
	select CRYPTO_SKCIPHER
	help
	  Selecting this will offload AES - ECB, CBC and CTR crypto
	  to the EIP-93 crypto engine.

config CRYPTO_DEV_EIP93_DES
	bool "Register legacy DES / 3DES algorithm with the Crypto API"
	default y
	select CRYPTO_DEV_EIP93_SKCIPHER
	select CRYPTO_LIB_DES
	select CRYPTO_SKCIPHER
	help
	  Selecting this will offload DES and 3DES ECB and CBC
	  crypto to the EIP-93 crypto engine.

config CRYPTO_DEV_EIP93_AEAD
	bool "Register AEAD algorithm with the Crypto API"
	default y
	select CRYPTO_DEV_EIP93_HMAC
	select CRYPTO_AEAD
	select CRYPTO_AUTHENC
	select CRYPTO_MD5
	select CRYPTO_SHA1
	select CRYPTO_SHA256
	help
	  Selecting this will offload AEAD authenc(hmac(x), cipher(y))
	  crypto to the EIP-93 crypto engine.
endif
```
