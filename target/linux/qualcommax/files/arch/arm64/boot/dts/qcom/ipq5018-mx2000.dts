// SPDX-License-Identifier: GPL-2.0-or-later OR MIT

/dts-v1/;

#include "ipq5018-mx-base.dtsi"

/ {
	model = "Linksys MX2000";
	compatible = "linksys,mx2000", "qcom,ipq5018";
};

&q6v5_wcss {
	status = "okay";
	boot-args = <0x01 0x04 0x02 0x0f 0x00 0x00>;
};

&wifi {
	status = "okay";

	qcom,rproc = <&q6_wcss_pd1>;
	qcom,userpd-subsys-name = "q6v5_wcss_userpd1";
	qcom,ath11k-calibration-variant = "Linksys-MX2000";
};

&wifi1 {
	status = "okay";

	qcom,rproc = <&q6_wcss_pd2>;
	qcom,userpd-subsys-name = "q6v5_wcss_userpd2";
	qcom,ath11k-calibration-variant = "Linksys-MX2000";
};
