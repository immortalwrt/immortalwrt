// SPDX-License-Identifier: GPL-2.0-or-later OR MIT

#include "ipq8074.dtsi"

&q6_region {
	reg = <0x0 0x4b000000 0x0 0x1000000>;
};

&q6_etr_region {
	reg = <0x0 0x4c000000 0x0 0x100000>;
};

&m3_dump_region {
	reg = <0x0 0x4c100000 0x0 0x100000>;
};

&ramoops_region {
	reg = <0x0 0x4c200000 0x0 0x100000>;
};
